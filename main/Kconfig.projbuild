## main/Kconfig.projbuild
```kconfig
menu "FlashComposer configuration"

    config FC_SPI_MOSI
        int "SPI MOSI Pin"
        default 23
        help
            SPI MOSI Pin

    config FC_SPI_MISO
        int "SPI MISO Pin"
        default 19
        help
            SPI MISO pin

    config FC_SPI_CS
        int "SPI Chip Select pin"
        default 5
        help
            SPI Chip Select pin

    config FC_SPI_SCLK
        int "SPI Clock pin"
        default 18
        help
            SPI Clock pin

    config FC_IO_RST
        int "Reset pin"
        default 2
        help
            Reset IO pin

    config FC_SPI_CLK_DEBUG
        bool "Enable slower SPI clock for debug"
        default n
        help
            Enable slower SPI clock (8MHz) for debugging, otherwise it goes to 40MHz

endmenu
```
